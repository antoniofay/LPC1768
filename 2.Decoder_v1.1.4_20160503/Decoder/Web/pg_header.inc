<body bgColor=#ffffff leftMargin=0 topMargin=10 marginwidth="0" marginheight="0" background="bck.jpg">
<div align=center style="width: 1440; height: 768">
<table width="797" height="100" border="0" cellpadding="0" cellspacing="0"><tr><td align="center">
           <font face="黑体" size="5"><b> [
           <a href="/configports.cgi">端口设置</a> |
					 <a href="/network.cgi">网络设置</a>  |
           <a href="/system.cgi">登陆设置</a>  |
					 <a href="/update.cgi">程序更新</a> ]</b></font>
</td></tr></table>			
<table style="border: 0px solid #000080" height=668 cellSpacing=0 cellPadding=0 width="1440">
 <tbody>
  <td colSpan=5 height=634 width="1080" vAlign=top style="background-repeat: repeat-y;">
   <div align=center>
    <center><font face="黑体">
     <table width="90%" border=0 align=center>
      <tbody><tr>
       <td width="95%">
